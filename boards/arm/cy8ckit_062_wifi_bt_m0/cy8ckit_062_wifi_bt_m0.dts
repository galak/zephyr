/dts-v1/;

#include <cypress/psoc6_cm0.dtsi>

/ {
	model = "cy8ckit_062_wifi_bt_m0 with a Cypress PSoC6 SoC";
	compatible = "cy8ckit_062_wifi_bt_m0", "PSoC6";

	aliases {
		uart-12 = &uart12;
	};

	chosen {
		zephyr,sram = &sram0;
		zephyr,flash = &flash0;
		zephyr,console = &uart12;
	};
};

&uart12 {
	status = "ok";
	current-speed = <115200>;
};
