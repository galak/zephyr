## Kconfig.defconfig
```kconfig
config FLASH_LOAD_OFFSET
	default $(shell,echo "9")

config CUSTOM_LINKER_SCRIPT
	default "$(shell,python3 $(ZEPHYR_BASE)/scripts/kconfig_dt.py FLASH_LOAD_OFFSET)"

#config FLASH_LOAD_SIZE
#	default DT_ZEPHYR_CODE_PARTITION_SIZE
```

## arch/arm/soc/cypress/psoc6/Kconfig.defconfig.series
```kconfig
# Kconfig.defconfig.series - Cypress Semiconductor PSoC6 series configuration options
#
# Copyright (c) 2018, Cypress
#
# SPDX-License-Identifier: Apache-2.0
#

if SOC_SERIES_PSOC62

config SOC_SERIES
	default "psoc6"

config NUM_IRQS
	int
	# must be >= the highest interrupt number used
	default 40

	config SYS_CLOCK_HW_CYCLES_PER_SEC
	int
	default 50000000

if UART_PSOC6

if SOC_PSOC6_M0

config UART_PSOC6_PORT_12
	def_bool y

endif # SOC_PSOC6_M0

if SOC_PSOC6_M4

config UART_PSOC6_PORT_5
	def_bool y

endif # SOC_PSOC6_M4

endif # UART_PSOC6

gsource "arch/arm/soc/cypress/psoc6/Kconfig.defconfig.psoc*"

endif # SOC_SERIES_PSOC62
```

## arch/arm/soc/cypress/psoc6/Kconfig.soc
```kconfig
# Kconfig.soc - Cypress PSOC6 MCU line
#
# Copyright (c) 2018, Cypress
#
# SPDX-License-Identifier: Apache-2.0
#

choice
prompt "Cypress PSoC6 MCU Selection"
depends on SOC_SERIES_PSOC62

config SOC_PART_NUMBER_CY8C6247BZI_D54
	bool "CY8C6247BZI_D54"

endchoice

if SOC_SERIES_PSOC62

config SOC_XXX
	bool

	help
	  This string holds the full part number of the SoC. It is a hidden
	  option that you should not set directly. The part number selection
	  choice defines the default value for this string.

endif # SOC_SERIES_PSOC62
```

## boards/arm/cy8ckit_062_wifi_bt_m4/Kconfig.defconfig
```kconfig
# Kconfig - PSoC6 WiFi-BT Pioneer Kit configuration
#
# Copyright (c) 2018 Cypress
# SPDX-License-Identifier: Apache-2.0
#

if 1 # BOARD_CY8CKIT_062_WIFI_BT_M4

config BOARD
	default "cy8ckit_062_wifi_bt_m4"

if GPIO

endif # GPIO

endif # BOARD_CY8CKIT_062_WIFI_BT_M4
```

## boards/arm/cy8ckit_062_wifi_bt_m4/cy8ckit_062_wifi_bt_m4_defconfig
```kconfig
CONFIG_ARM=y
CONFIG_SOC_PSOC6_M4=y
CONFIG_SOC_FAMILY_PSOC6=y
CONFIG_SOC_SERIES_PSOC62=y
CONFIG_SOC_PART_NUMBER_CY8C6247BZI_D54=y
CONFIG_BOARD_CY8CKIT_062_WIFI_BT_M4=y
CONFIG_CORTEX_M_SYSTICK=y
CONFIG_PINMUX=y
CONFIG_XIP=y
CONFIG_PRINTK=y

# UART driver
CONFIG_SERIAL=y
CONFIG_SERIAL_HAS_DRIVER=y
CONFIG_UART_PSOC6=y
CONFIG_UART_PSOC6_PORT_5=y

# Console driver
CONFIG_CONSOLE=y
CONFIG_UART_CONSOLE=y
CONFIG_CONSOLE_INPUT_MAX_LINE_LEN=128
CONFIG_CONSOLE_HAS_DRIVER=y

CONFIG_CONSOLE_HANDLER=y
CONFIG_STDOUT_CONSOLE=y
CONFIG_EARLY_CONSOLE=y
```

## boards/arm/mps3_an524/Kconfig.board
```kconfig
# Copyright (c) 2018-2019 Linaro Limited
# SPDX-License-Identifier: Apache-2.0

config BOARD_MPS3_AN524
	bool "ARM Cortex-M33 SMM on V2M-MPS3 (AN521)"
	depends on SOC_MPS3_AN524
	select QEMU_TARGET
	select HAS_COVERAGE_SUPPORT
```

## boards/arm/mps3_an524/Kconfig.defconfig
```kconfig
# Copyright (c) 2021 Linaro Limited
# SPDX-License-Identifier: Apache-2.0

if BOARD_MPS3_AN524

config BOARD
	default "mps3_an524"

if GPIO

config GPIO_CMSDK_AHB
	default y

endif # GPIO

if SERIAL

config UART_CMSDK_APB
	default y

config UART_INTERRUPT_DRIVEN
	default y

endif # SERIAL

config WDOG_CMSDK_APB
	default y
	depends on WATCHDOG

config I2C_SBCON
	default y
	depends on I2C

endif
```

## boards/arm/v2m_musca/Kconfig.board
```kconfig
#
# Copyright (c) 2018 Linaro Limited
#
# SPDX-License-Identifier: Apache-2.0
#

config BOARD_MUSCA_A
	bool "ARM Cortex-M33 SMM on V2M-MUSCA"
	depends on SOC_SERIES_MUSCA

config BOARD_MUSCA_A_NONSECURE
	bool "ARM Cortex-M33 SMM on V2M-MUSCA (Non-Secure)"
	depends on SOC_SERIES_MUSCA
	select ARM_NONSECURE_FIRMWARE
```

## drivers/serial/Kconfig.psoc6
```kconfig
# Kconfig - Cypress UART configuration
#
# Copyright (c) 2016 Cypress
#
# SPDX-License-Identifier: Apache-2.0
#

menuconfig UART_PSOC6
	bool "PSoC6 MCU serial driver"
	default n
	depends on SOC_FAMILY_PSOC6
	select SERIAL_HAS_DRIVER
	help
	  This option enables the UART driver for PSoC6 family of processors.

if UART_PSOC6

# --- port 6 ---

config UART_PSOC6_PORT_12
	bool "Enable PSOC6 SCB6 on Port 12"
	default n
	depends on UART_PSOC6
	help
	  Enable support for UART on port 12 in the driver.

config UART_PSOC6_PORT_5
	bool "Enable PSOC6 SCB6 on Port 5"
	default n
	depends on UART_PSOC6
	help
	  Enable support for UART on port 5 in the driver.


endif # UART_PSOC6
```

## dts/bindings/bluetooth/zephyr,bt-hci-spi-slave.yaml
```yaml
#
# Copyright (c) 2018, Linaro Limited
#
# SPDX-License-Identifier: Apache-2.0
#
---
title: Bluetooth module based on Zephyr's Bluetooth HCI SPI driver
version: 0.1

description: >
    This binding gives the base representation of a bluetooth module which use
    Zephyr's bluetooth Host Controller Interface SPI driver (e.g. nRF51822).

parent:
    bus: spi

properties:
    compatible:
      type: string
      category: required
      description: compatible strings
      generation: define
      constraint: "zephyr,bt-hci-spi-slave"

...
```

## lib/libc/common/Kconfig
```kconfig
# Copyright (c) 2023 Intel Corporation
# SPDX-License-Identifier: Apache-2.0

config COMMON_LIBC_TIME
	bool
	help
	  common implementation of time().

config COMMON_LIBC_GMTIME_R
	bool
	help
	  common implementation of gmtime_r().
```

## soc/arm/arm/mps3/Kconfig.defconfig.mps3_an524
```kconfig
# Copyright (c) 2021 Linaro Limited
# SPDX-License-Identifier: Apache-2.0

if SOC_MPS3_AN524

config SOC
	default "mps3_an524"

config NUM_IRQS
	default 96

endif
```

## soc/arm/arm/mps3/Kconfig.soc
```kconfig
# Copyright (c) 2017-2021 Linaro Limited
# SPDX-License-Identifier: Apache-2.0

choice
	prompt "Arm MPS3 SoCs"
	depends on SOC_SERIES_MPS3

config SOC_MPS3_AN524
	bool "ARM Cortex-M33 SMM-SSE-200 on V2M-MPS3 (AN524)"
	select CPU_CORTEX_M33
	select CPU_HAS_ARM_SAU
	select CPU_HAS_ARM_MPU

config SOC_MPS3_AN547
	bool "Arm Cortex-M55 SSE-300 on-MPS3 (AN547)"
	select CPU_CORTEX_M55
	select CPU_HAS_ARM_SAU
	select CPU_HAS_ARM_MPU

endchoice
```

## soc/arm/nxp_lpc/lpc55S6x/Kconfig.defconfig.lpc55S69_m33_cpu0
```kconfig
# Kconfig - NXP LPC54114 M33 CPU0 platform configuration options

#
# Copyright (c) 2017, NXP
#
# SPDX-License-Identifier: Apache-2.0
#

if SOC_LPC55S69_M33_CPU0

config SOC
	string
	default "lpc55S69_m33_cpu0"

if PINMUX

config PINMUX_MCUX_LPC
	default y

endif # PINMUX

if GPIO

config GPIO_MCUX_LPC
	default y

endif # GPIO

if SERIAL

config USART_MCUX_LPC
	default y

endif # SERIAL

endif # SOC_LPC55S69_M33_CPU0
```

## soc/arm/nxp_lpc/lpc55S6x/Kconfig.defconfig.series
```kconfig
# Kconfig -  LPC55S6X series configuration options
#
# Copyright (c) 2017, NXP
#
# SPDX-License-Identifier: Apache-2.0
#

if SOC_SERIES_LPC55S6X

config SOC_SERIES
	default "lpc55S6x"

config NUM_IRQS
	int
	# must be >= the highest interrupt number used
	default 60

source "soc/arm/nxp_lpc/lpc55S6x/Kconfig.defconfig.lp*"

endif # SOC_SERIES_LPC55S6X
```

## soc/arm/nxp_lpc/lpc55S6x/Kconfig.series
```kconfig
# Kconfig - LPC LPC55S6X MCU line
#
# Copyright (c) 2017, NXP
#
# SPDX-License-Identifier: Apache-2.0
#

config SOC_SERIES_LPC55S6X
	bool "LPC LPC55S6x Series MCU"
	select HAS_MCUX
	select SOC_FAMILY_LPC
	select CPU_HAS_SYSTICK
	help
	  Enable support for LPC LPC55S6X MCU series
```

## soc/arm/nxp_lpc/lpc55S6x/Kconfig.soc
```kconfig
# Kconfig - LPC LPC55S6X MCU line
#
# Copyright (c) 2017, NXP
#
# SPDX-License-Identifier: Apache-2.0
#

choice
prompt "LPC LPC55S6X MCU Selection"
depends on SOC_SERIES_LPC55S6X

config SOC_LPC55S69_M33_CPU0
	bool "SOC_LPC55S69 M33 [CPU 0]"
	select CPU_CORTEX_M33
	select CPU_HAS_ARM_SAU
	select CPU_HAS_ARM_MPU
	select CPU_HAS_FPU
	select ARMV8_M_DSP
#	select PLATFORM_SPECIFIC_INIT # Used for releasing second core

config SOC_LPC55S69_M33_CPU1
	bool "SOC_LPC55S69 M33 [CPU 1]"
	select CPU_CORTEX_M33

endchoice

if SOC_SERIES_LPC55S6X

config SOC_PART_NUMBER_LPC55S69JBD100
	bool

config SOC_PART_NUMBER_LPC55S6X
	string
	default "LPC55S69JBD100" if SOC_PART_NUMBER_LPC55S69JBD100

	help
	  This string holds the full part number of the SoC. It is a hidden
	  option that you should not set directly. The part number selection
	  choice defines the default value for this string.

endif # SOC_SERIES_LPC55S6X
```
