## CMakeLists.txt
```
# Copyright (c) 2018 Cypress Semiconductor
#
# SPDX-License-Identifier: Apache-2.0
#

set(BOARD cy8ckit_062_wifi_bt_m4)

include($ENV{ZEPHYR_BASE}/cmake/app/boilerplate.cmake NO_POLICY_SCOPE)
project(NONE)

enable_language(C ASM)

# Location of external dependencies:
set(LIB_DIR "${CMAKE_CURRENT_SOURCE_DIR}/../lib")
set(AUTH_DIR "${CMAKE_CURRENT_SOURCE_DIR}/../auth_mgr")

target_sources(app PRIVATE src/main.c
)

target_include_directories(app PRIVATE 
               ${AUTH_DIR}/
			   ./src)
```

## sample.yaml
```
sample:
  description: SPM example for PSoC6 CM0p
    application
  name: spm_psoc6
  platforms: all
common:
    tags: samples
    harness: console
    harness_config:
      type: one_line
      regex:
        - "SPM PSoC6 (.*)"
tests:
  singlethread:
    extra_args: CONF_FILE=prj.conf
    filter: not CONFIG_BT and not CONFIG_GPIO_SCH and ASSERT == 0
  test:
    tags: samples
```

## prj.conf
```kconfig
# nothing here

CONFIG_HEAP_MEM_POOL_SIZE=32384
```

## src/main.c
```c
/*
 * Copyright (c) 2012-2014 Wind River Systems, Inc.
 *
 * SPDX-License-Identifier: Apache-2.0
 */

#include <zephyr.h>
#include <misc/printk.h>

#include "main.h"
#include "cy_syslib.h"
#include "cy_gpio.h"
#include "cycfg_pins.h"
#include "cy_scb_uart.h"
#include <string.h>

#define CY_CORTEX_M4_APPL_ADDR_SPM  0x10060000
#define SHARED_MEM_STARTD_ADDR      0x08023000
#define SHARED_MEM_END_ADDR         0x08024000

// Forward Declarations
// --------------------

IPC_STRUCT_Type             *ipc_channel_handle;
static IPC_INTR_STRUCT_Type *ipc_interrupt_ptr;

void on_vacancy(void *arg)
{
    CY_ASSERT(arg != NULL); // In this implementation, arg must not be NULL
    IPC_STRUCT_Type *ipc_chan_handle = (IPC_STRUCT_Type *)arg;
    
    printf("--->CB: CM0+ TX Q became NOT FULL!\n");
    
    Cy_IPC_Drv_AcquireNotify(ipc_chan_handle, (1uL << SPM_IPC_NOTIFY_CM4_INTR));
};

/*******************************************************************************
* Function Name: ipc_interrupt_handler
*******************************************************************************/
void ipc_interrupt_handler(void)
{
	char *__shared_memory_start = (char *)SHARED_MEM_STARTD_ADDR;
    printk("CM0+: ipc_interrupt_handler INTR = 0x%x\n", (unsigned int)(ipc_interrupt_ptr->INTR));
	printk("CM0+: message: %s\n", __shared_memory_start);
	
	on_vacancy(ipc_channel_handle);

    // Clear the interrupt and make a dummy read to avoid double interrupt occurrence:
    // - The double interrupt’s triggering is caused by buffered write operations on bus
    // - The dummy read of the status register is indeed required to make sure previous write completed before leaving ISR
    // Note: This is a direct clear using the IPC interrupt register and not clear of an NVIC register
    Cy_IPC_Drv_ClearInterrupt(ipc_interrupt_ptr, CY_IPC_NO_NOTIFICATION, (1uL << SPM_IPC_CHANNEL));
}

void main(void)
{
	printk("CM0+: Hello World! %s\n", CONFIG_ARCH);
	
	// Interrupts configuration for CM0+
    // * See ce216795_common.h for occupied interrupts
    // -----------------------------------------------

    // Configure interrupts ISR / MUX and priority
    cy_stc_sysint_t ipc_intr_Config;
    ipc_intr_Config.intrSrc = (IRQn_Type)NvicMux3_IRQn; // Can be any Mux we choose
    ipc_intr_Config.cm0pSrc = (cy_en_intr_t)cpuss_interrupts_ipc_0_IRQn + SPM_IPC_NOTIFY_CM0P_INTR;    // Must match the interrupt we trigger using NOTIFY on CM4
    ipc_intr_Config.intrPriority = 1;
    (void)Cy_SysInt_Init(&ipc_intr_Config, ipc_interrupt_handler);

    // Set specific NOTIFY interrupt mask only.
    // Only the interrupt sources with their masks enabled can trigger the interrupt.
    ipc_interrupt_ptr = Cy_IPC_Drv_GetIntrBaseAddr(SPM_IPC_NOTIFY_CM0P_INTR);
    Cy_IPC_Drv_SetInterruptMask(ipc_interrupt_ptr, 0x0, 1 << SPM_IPC_CHANNEL);

    // Enable the interrupt
    NVIC_EnableIRQ(ipc_intr_Config.intrSrc);

    ipc_channel_handle = Cy_IPC_Drv_GetIpcBaseAddress(SPM_IPC_CHANNEL);

	/* Init interrupt in zephyr */
    IRQ_DIRECT_CONNECT(NvicMux3_IRQn, 1, ipc_interrupt_handler, 0);
    irq_enable(NvicMux3_IRQn);

    // Enable CM4
    Cy_SysEnableCM4(CY_CORTEX_M4_APPL_ADDR_SPM);
	
	while(1)
	{
        Cy_GPIO_Inv(LED_RED_PORT, LED_RED_PIN); /* toggle the pin */
        Cy_SysLib_Delay(3000);
	}
}
 
```

## src/main.h
```c
/*******************************************************************************
* \file main.h
*
* \version  1.0
*
* \brief Function prototypes and constants available to the example project.
*
********************************************************************************
* \copyright
*
* © 2018, Cypress Semiconductor Corporation
* or a subsidiary of Cypress Semiconductor Corporation. All rights
* reserved.
*
* This software, including source code, documentation and related
* materials (“Software”), is owned by Cypress Semiconductor
* Corporation or one of its subsidiaries (“Cypress”) and is protected by
* and subject to worldwide patent protection (United States and foreign),
* United States copyright laws and international treaty provisions.
* Therefore, you may use this Software only as provided in the license
* agreement accompanying the software package from which you
* obtained this Software (“EULA”).
*
* If no EULA applies, Cypress hereby grants you a personal, non-
* exclusive, non-transferable license to copy, modify, and compile the
* Software source code solely for use in connection with Cypress’s
* integrated circuit products. Any reproduction, modification, translation,
* compilation, or representation of this Software except as specified
* above is prohibited without the express written permission of Cypress.
*
* Disclaimer: THIS SOFTWARE IS PROVIDED AS-IS, WITH NO
* WARRANTY OF ANY KIND, EXPRESS OR IMPLIED, INCLUDING,
* BUT NOT LIMITED TO, NONINFRINGEMENT, IMPLIED
* WARRANTIES OF MERCHANTABILITY AND FITNESS FOR A
* PARTICULAR PURPOSE. Cypress reserves the right to make
* changes to the Software without notice. Cypress does not assume any
* liability arising out of the application or use of the Software or any
* product or circuit described in the Software. Cypress does not
* authorize its products for use in any products where a malfunction or
* failure of the Cypress product may reasonably be expected to result in
* significant property damage, injury or death (“High Risk Product”). By
* including Cypress’s product in a High Risk Product, the manufacturer
* of such system or application assumes all risk of such use and in doing
* so agrees to indemnify Cypress against all liability.
*
******************************************************************************/
#ifndef MAIN_H
#define MAIN_H


#include "cmsis_compiler.h"
#include <stdio.h>
#include "cy_scb_uart.h"
#include "cy_sysint.h"
#include "cy_sysclk.h"
#include "cy_ipc_config.h"
#include "cy_ipc_drv.h"

// IPC channel for SPM IPC
#define SPM_IPC_CHANNEL 8u

// Interrupts for SPM IPC
#define SPM_IPC_NOTIFY_CM4_INTR     (CY_IPC_INTR_SPARE + 1) // CM0+ to CM4 notify interrupt number
#define SPM_IPC_NOTIFY_CM0P_INTR    (CY_IPC_INTR_SPARE + 2) // CM4 to CM0+ notify interrupt number


#define UART_DEB_PUT_CHAR(...)                  while(1UL != Cy_SCB_UART_Put(SCB6, __VA_ARGS__))
#define DBG_PRINTF(...)                         (printf(__VA_ARGS__))

/* Assign pins for UART on SCB6: P12[0], P12[1] */
#define UART_PORT       P12_0_PORT
#define UART_RX_NUM     P12_0_NUM
#define UART_TX_NUM     P12_1_NUM

/* Assign divider type and number for UART */
#define UART_CLK_DIV_TYPE     (CY_SYSCLK_DIV_8_BIT)
#define UART_CLK_DIV_NUMBER   (PERI_DIV_8_NR - 1u)

#endif /* MAIN_H */

/* [] END OF FILE */
```
