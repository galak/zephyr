/*
 * Copyright (c) 2019 Linaro Limited
 *
 * SPDX-License-Identifier: Apache-2.0
 */

#include <mem.h>

/ {
	chosen {
		/*
		 * shared memory reserved for the inter-processor communication
		 */
		zephyr,ipc_shm = &sramx;
		zephyr,ipc = &mhu0;
	};

	sramx: memory@28200000 {
		compatible = "mmio-sram";
		reg = <0x28200000 DT_SIZE_K(32)>;
	};
};
